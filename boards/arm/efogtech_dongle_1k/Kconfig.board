## boards/arm/efogtech_dongle_1k/Kconfig.board
```kconfig
config BOARD_EFOGTECH_DONGLE_1K
    bool "efogtech_dongle_1k"
    depends on SOC_NRF52833_QIAA
```

## boards/arm/efogtech_dongle_1k/Kconfig.defconfig
```kconfig
# SPDX-License-Identifier: MIT

if BOARD_EFOGTECH_DONGLE_1K

config BOARD
    default "efogtech_dongle_1k"

config USB_NRFX
    default y

config USB_DEVICE_STACK
    default y


endif # BOARD_EFOGTECH_DONGLE_1K
```

## boards/arm/efogtech_dongle_1k/efogtech_dongle_1k_defconfig
```kconfig
# SPDX-License-Identifier: MIT

CONFIG_SOC_SERIES_NRF52X=y
CONFIG_SOC_NRF52833_QIAA=y
CONFIG_BOARD_EFOGTECH_DONGLE_1K=y
CONFIG_ARM_MPU=y
CONFIG_HW_STACK_PROTECTION=n

CONFIG_USE_DT_CODE_PARTITION=y
CONFIG_BUILD_OUTPUT_UF2=y

CONFIG_FLASH=y
CONFIG_FLASH_PAGE_LAYOUT=y
CONFIG_FLASH_MAP=y
CONFIG_NVS=y
CONFIG_SETTINGS_NVS=y
CONFIG_SETTINGS=y

CONFIG_CLOCK_CONTROL_NRF=y
CONFIG_CLOCK_CONTROL_NRF_K32SRC_RC=y

CONFIG_GPIO=y
CONFIG_PINCTRL=y

CONFIG_USB_DEVICE_STACK=y
CONFIG_USB_DEVICE_HID=y
CONFIG_USB_HID_POLL_INTERVAL_MS=1
CONFIG_USB_DEVICE_VID=0x0011
CONFIG_USB_DEVICE_PID=0x0007
CONFIG_USB_DEVICE_MANUFACTURER="efog.tech"
CONFIG_USB_DEVICE_PRODUCT="Dongle 1k"
CONFIG_USB_CDC_ACM_LOG_LEVEL_OFF=y

CONFIG_LOG_MAX_LEVEL=4
CONFIG_LOG_SPEED=y
CONFIG_SIZE_OPTIMIZATIONS=n
CONFIG_SPEED_OPTIMIZATIONS=y

CONFIG_SERIAL=y
CONFIG_CONSOLE=y
CONFIG_UART_CONSOLE=y
CONFIG_UART_LINE_CTRL=y
```

## boards/arm/efogtech_trackball_0/Kconfig.board
```kconfig
config BOARD_EFOGTECH_TRBL_52833
    bool "efogtech_trackball_0"
    depends on SOC_NRF52833_QIAA

config BOARD_EFOGTECH_0_VER_MAJOR
    int "0"

config BOARD_EFOGTECH_0_VER_MINOR
    int "2"

config BOARD_EFOGTECH_0_VER_PATCH
    int "0"
```

## boards/arm/efogtech_trackball_0/efogtech_trackball_0_defconfig
```kconfig
# SPDX-License-Identifier: MIT

CONFIG_SOC_SERIES_NRF52X=y
CONFIG_SOC_NRF52833_QIAA=y
CONFIG_BOARD_EFOGTECH_TRBL_52833=y
CONFIG_ARM_MPU=y
CONFIG_SERIAL=y
CONFIG_USE_DT_CODE_PARTITION=y
CONFIG_BUILD_OUTPUT_UF2=y
CONFIG_MPU_ALLOW_FLASH_WRITE=y
CONFIG_NVS=y
CONFIG_SETTINGS_NVS=y
CONFIG_FLASH=y
CONFIG_FLASH_PAGE_LAYOUT=y
CONFIG_FLASH_MAP=y
CONFIG_CLOCK_CONTROL_NRF=y
CONFIG_CLOCK_CONTROL_NRF_K32SRC_RC=y
CONFIG_ZMK_USB=y
CONFIG_ZMK_BLE=y
CONFIG_ZMK_POINTING=y
CONFIG_WS2812_STRIP=y
CONFIG_ZMK_BACKLIGHT=y
CONFIG_LED_PWM=y
CONFIG_LOG_SPEED=y
CONFIG_SIZE_OPTIMIZATIONS=n
CONFIG_SPEED_OPTIMIZATIONS=y
CONFIG_LOG_MAX_LEVEL=4
CONFIG_LOG_PROCESS_THREAD_STARTUP_DELAY_MS=0
CONFIG_ZMK_BEHAVIOR_TRIGGER_ON_BOOT_DELAY_MS=1650
CONFIG_SPI=y
CONFIG_SPI_ASYNC=y
CONFIG_PWM=y
CONFIG_INPUT=y
CONFIG_GPIO=y
CONFIG_PINCTRL=y
CONFIG_EC11=y
CONFIG_EC11_TRIGGER_GLOBAL_THREAD=y
CONFIG_ACPI_HID_LEN_MAX=24
CONFIG_NRF_STORE_REBOOT_TYPE_GPREGRET=n
CONFIG_CBPRINTF_FP_SUPPORT=n
CONFIG_USB_HID_POLL_INTERVAL_MS=1
CONFIG_ZMK_STUDIO_TRANSPORT_BLE_PREF_LATENCY=8
CONFIG_UART_INTERRUPT_DRIVEN=y
CONFIG_USB_DEVICE_VID=0x0011
CONFIG_USB_DEVICE_PID=0x0006
CONFIG_USB_DEVICE_MANUFACTURER="efog.tech"
CONFIG_ZMK_BLE_MOUSE_REPORT_QUEUE_SIZE=1
CONFIG_ZMK_BLE_EXPERIMENTAL_CONN=y
CONFIG_ZMK_BLE_EXPERIMENTAL_SEC=y
CONFIG_ZMK_BLE_EXPERIMENTAL_FEATURES=y
CONFIG_ZMK_BLE_PASSKEY_ENTRY=n
CONFIG_BT_CTLR_TX_PWR_PLUS_8=y
CONFIG_BT_CTLR_CONN_RSSI=y
CONFIG_BT_CTLR_TX_PWR_DYNAMIC_CONTROL=y
CONFIG_BT_CTLR_PHY_2M=y
CONFIG_BT_PERIPHERAL_PREF_MAX_INT=6
CONFIG_BT_TPS=y
CONFIG_BT_GATT_ENFORCE_SUBSCRIPTION=y
CONFIG_ZMK_POINTER_2S_MIXER=y
CONFIG_WS2812_STRIP=y
CONFIG_NFCT_PINS_AS_GPIOS=y
CONFIG_ZMK_RGB_UNDERGLOW_EXT_POWER=n
CONFIG_ZMK_EXT_POWER=y
CONFIG_ZMK_PM_SOFT_OFF=y
CONFIG_ZMK_USB_LOGGING=y
CONFIG_PM_DEVICE=y
CONFIG_BT_DEVICE_NAME_MAX=28
CONFIG_ZMK_SETTINGS_SAVE_DEBOUNCE=2500
CONFIG_ZMK_BEHAVIOR_METADATA=y
CONFIG_ZMK_KEYBOARD_NAME="Endgame Trackball"
CONFIG_ZMK_STUDIO=y
CONFIG_BT_MAX_CONN=5
CONFIG_BT_MAX_PAIRED=5
CONFIG_ZMK_BACKLIGHT=n
CONFIG_ARM_MPU=y
CONFIG_POINTER_2S_MIXER_REMAINDER_TTL=16
CONFIG_POINTER_2S_MIXER_DIRECTION_FILTER_EN=y
CONFIG_POINTER_2S_MIXER_34_FILTER_EN=y
CONFIG_POINTER_2S_MIXER_SENS_DRIFT_CORRECTION=1
CONFIG_POINTER_2S_MIXER_TWIST_REMAINDER_TTL=100
CONFIG_POINTER_2S_MIXER_FEEDBACK_MAX_CONTINUOUS=65
CONFIG_POINTER_2S_MIXER_FEEDBACK_COOLDOWN=160
CONFIG_POINTER_2S_MIXER_SYNC_WINDOW_MS=6
CONFIG_POINTER_2S_MIXER_FEEDBACK_EN=y
CONFIG_POINTER_2S_MIXER_SCROLL_DISABLES_POINTER=n
CONFIG_POINTER_2S_MIXER_POINTER_AFTER_SCROLL_ACTIVATION=160
CONFIG_POINTER_2S_MIXER_LAZY_INIT=n
CONFIG_POINTER_2S_MIXER_DIRECTION_FILTER_TTL=80
CONFIG_POINTER_2S_MIXER_TWIST_FILTER_TTL=65
CONFIG_POINTER_2S_MIXER_TWIST_FILTER_DEBOUNCE=35
CONFIG_POINTER_2S_MIXER_SIGNIFICANT_MOVEMENT_MUL=15
CONFIG_POINTER_2S_MIXER_DELTA_Y_OVER_TRANS_MAG_MUL=4
CONFIG_ZMK_RGB_UNDERGLOW=y
CONFIG_ZMK_RGB_UNDERGLOW_EFF_START=2
CONFIG_ZMK_RGB_UNDERGLOW_BRT_START=100
CONFIG_ZMK_RGB_UNDERGLOW_SPD_START=1
CONFIG_ZMK_RGB_UNDERGLOW_ON_START=n
CONFIG_ZMK_INPUT_PROCESSOR_REPORT_RATE_LIMIT=y
CONFIG_ZMK_INPUT_PROCESSOR_REPORT_RATE_LIMIT_DEFAULT=2
CONFIG_ZMK_RGB_UNDERGLOW_BRT_MIN=100
CONFIG_ZMK_RGB_UNDERGLOW_BRT_MAX=100
CONFIG_EC11_ISH=y
CONFIG_ZMK_POINTING_SMOOTH_SCROLLING=y
CONFIG_ZMK_KSCAN_DEBOUNCE_PRESS_MS=0
CONFIG_ZMK_KSCAN_DEBOUNCE_RELEASE_MS=0
CONFIG_ZMK_AXIS_CLAMPER=y
CONFIG_PAW3395=y
```

## boards/arm/holyiot_dongle_1k/Kconfig.board
```kconfig
config BOARD_HOLYIOT_DONGLE_1K
    bool "holyiot_dongle_1k"
    depends on SOC_NRF52840_QIAA
```

## boards/arm/holyiot_dongle_1k/Kconfig.defconfig
```kconfig
# SPDX-License-Identifier: MIT

if BOARD_HOLYIOT_DONGLE_1K

config BOARD
    default "holyiot_dongle_1k"

config USB_NRFX
    default y

config USB_DEVICE_STACK
    default y

endif
```

## boards/efogtech/efogtech_trackball_0/Kconfig.defconfig
```kconfig
# Electronut Labs Papyr board configuration

# Copyright (c) 2020 The ZMK Contributors
# SPDX-License-Identifier: MIT

if BOARD_EFOGTECH_TRBL_52833

config ZMK_KEYBOARD_NAME
    default "Endgame"

config EC11
    default y

config PWM
    default y

config LED_PWM
    default y

config SPI
    default y

config BT_CTLR
    default BT

config ZMK_BLE
	default y

config ZMK_USB
	default y

config USB_DEVICE_STACK
	default y

config USB_NRFX
    default y

endif # BOARD_EFOGTECH_TRBL_52833
```

## boards/efogtech/efogtech_trackball_0/Kconfig.efogtech_trackball_0
```kconfig
# SPDX-License-Identifier: Apache-2.0

config BOARD_EFOGTECH_TRBL_52833
    bool "true"
	select SOC_NRF52833_QIAA

config BOARD_EFOGTECH_0_VER_MAJOR
    int "0"

config BOARD_EFOGTECH_0_VER_MINOR
    int "2"

config BOARD_EFOGTECH_0_VER_PATCH
    int "0"
```

## boards/efogtech/efogtech_trackball_0/efogtech_trackball_0_defconfig
```kconfig
# SPDX-License-Identifier: MIT

CONFIG_BOARD_EFOGTECH_TRBL_52833=y
CONFIG_BOARD_EFOGTECH_0_VER_MAJOR=0
CONFIG_BOARD_EFOGTECH_0_VER_MINOR=2
CONFIG_BOARD_EFOGTECH_0_VER_PATCH=3
CONFIG_PMW3610=y
CONFIG_ARM_MPU=y
CONFIG_HW_STACK_PROTECTION=n
CONFIG_USB_CDC_ACM_LOG_LEVEL_OFF=y
CONFIG_USE_DT_CODE_PARTITION=y
CONFIG_BUILD_OUTPUT_UF2=y
CONFIG_NVS=y
CONFIG_SETTINGS_NVS=y
CONFIG_FLASH=y
CONFIG_FLASH_PAGE_LAYOUT=y
CONFIG_FLASH_MAP=y
CONFIG_CLOCK_CONTROL_NRF=y
CONFIG_CLOCK_CONTROL_NRF_K32SRC_RC=y
CONFIG_ZMK_USB=y
CONFIG_ZMK_BLE=y
CONFIG_ZMK_POINTING=y
CONFIG_ZMK_BACKLIGHT=n
CONFIG_LED_PWM=n
CONFIG_LOG_SPEED=y
CONFIG_SIZE_OPTIMIZATIONS=n
CONFIG_SPEED_OPTIMIZATIONS=y
CONFIG_LOG_MAX_LEVEL=3
CONFIG_LOG_PROCESS_THREAD_STARTUP_DELAY_MS=0
CONFIG_ZMK_BEHAVIOR_TRIGGER_ON_BOOT_DELAY_MS=1650
CONFIG_SPI=y
CONFIG_SPI_ASYNC=y
CONFIG_PWM=n
CONFIG_INPUT=y
CONFIG_GPIO=y
CONFIG_PINCTRL=y
CONFIG_USB_HID_POLL_INTERVAL_MS=1
CONFIG_UART_INTERRUPT_DRIVEN=y
CONFIG_USB_DEVICE_VID=0x0011
CONFIG_USB_DEVICE_PID=0x0006
CONFIG_USB_DEVICE_MANUFACTURER="efog.tech"
CONFIG_ZMK_BLE_MOUSE_REPORT_QUEUE_SIZE=1
CONFIG_ZMK_BLE_EXPERIMENTAL_CONN=y
CONFIG_ZMK_BLE_EXPERIMENTAL_SEC=y
CONFIG_ZMK_BLE_EXPERIMENTAL_FEATURES=y
CONFIG_ZMK_BLE_PASSKEY_ENTRY=n
CONFIG_BT_CTLR_TX_PWR_PLUS_8=y
CONFIG_BT_CTLR_CONN_RSSI=y
CONFIG_BT_CTLR_TX_PWR_DYNAMIC_CONTROL=y
CONFIG_BT_CTLR_PHY_2M=y
CONFIG_BT_PERIPHERAL_PREF_MAX_INT=6
CONFIG_BT_TPS=y
CONFIG_BT_GATT_ENFORCE_SUBSCRIPTION=y
CONFIG_ZMK_POINTER_2S_MIXER=y
CONFIG_PMW3610_INIT_POWER_UP_EXTRA_DELAY_MS=10
CONFIG_PMW3610_REPORT_INTERVAL_MIN=0
CONFIG_PMW3610_SMART_ALGORITHM=y
CONFIG_PMW3610_SQUAL_LOG=n
CONFIG_PMW3610_SQUAL_LOG_INTERVAL=250
CONFIG_PMW3610_ANTI_WARP=y
CONFIG_PMW3610_ANTI_WARP_THRES=100
CONFIG_ZMK_RGB_UNDERGLOW_EXT_POWER=n
CONFIG_ZMK_EXT_POWER=y
CONFIG_ZMK_PM_SOFT_OFF=y
CONFIG_ZMK_USB_LOGGING=y
CONFIG_PM_DEVICE=y
CONFIG_ZMK_SETTINGS_SAVE_DEBOUNCE=2500
CONFIG_ZMK_BEHAVIOR_METADATA=y
CONFIG_ZMK_KEYBOARD_NAME="Endgame"
CONFIG_ZMK_STUDIO=y
CONFIG_BT_MAX_CONN=5
CONFIG_BT_MAX_PAIRED=5
CONFIG_POINTER_2S_MIXER_REMAINDER_TTL=16
CONFIG_POINTER_2S_MIXER_DIRECTION_FILTER_EN=y
CONFIG_POINTER_2S_MIXER_34_FILTER_EN=y
CONFIG_POINTER_2S_MIXER_SENS_DRIFT_CORRECTION=1
CONFIG_POINTER_2S_MIXER_TWIST_REMAINDER_TTL=100
CONFIG_POINTER_2S_MIXER_FEEDBACK_MAX_CONTINUOUS=65
CONFIG_POINTER_2S_MIXER_FEEDBACK_COOLDOWN=160
CONFIG_POINTER_2S_MIXER_SYNC_WINDOW_MS=6
CONFIG_POINTER_2S_MIXER_FEEDBACK_EN=y
CONFIG_POINTER_2S_MIXER_SCROLL_DISABLES_POINTER=n
CONFIG_POINTER_2S_MIXER_POINTER_AFTER_SCROLL_ACTIVATION=160
CONFIG_POINTER_2S_MIXER_LAZY_INIT=n
CONFIG_POINTER_2S_MIXER_DIRECTION_FILTER_TTL=80
CONFIG_POINTER_2S_MIXER_TWIST_FILTER_TTL=65
CONFIG_POINTER_2S_MIXER_TWIST_FILTER_DEBOUNCE=35
CONFIG_POINTER_2S_MIXER_SIGNIFICANT_MOVEMENT_MUL=15
CONFIG_POINTER_2S_MIXER_DELTA_Y_OVER_TRANS_MAG_MUL=4
CONFIG_ZMK_RGB_UNDERGLOW=y
CONFIG_ZMK_RGB_UNDERGLOW_EFF_START=2
CONFIG_ZMK_RGB_UNDERGLOW_BRT_START=100
CONFIG_ZMK_RGB_UNDERGLOW_SPD_START=1
CONFIG_ZMK_RGB_UNDERGLOW_ON_START=n
CONFIG_PMW3610_REST1_SAMPLE_TIME_MS=35
CONFIG_PMW3610_REST2_SAMPLE_TIME_MS=65
CONFIG_PMW3610_REST3_SAMPLE_TIME_MS=250
CONFIG_PMW3610_RUN_DOWNSHIFT_TIME_MS=2500
CONFIG_PMW3610_REST1_DOWNSHIFT_TIME_MS=15000
CONFIG_PMW3610_REST2_DOWNSHIFT_TIME_MS=150000
CONFIG_PMW3610_IGNORE_FIRST_N=15
CONFIG_PMW3610_IGNORE_AFTER_REST=n
CONFIG_ZMK_INPUT_PROCESSOR_REPORT_RATE_LIMIT=y
CONFIG_ZMK_INPUT_PROCESSOR_REPORT_RATE_LIMIT_DEFAULT=2
CONFIG_ZMK_RGB_UNDERGLOW_BRT_MIN=100
CONFIG_ZMK_RGB_UNDERGLOW_BRT_MAX=100
CONFIG_EC11=n
CONFIG_EC11_ISH=y
CONFIG_ZMK_POINTING_SMOOTH_SCROLLING=y
CONFIG_ZMK_KSCAN_DEBOUNCE_PRESS_MS=0
CONFIG_ZMK_KSCAN_DEBOUNCE_RELEASE_MS=0
CONFIG_ZMK_AXIS_CLAMPER=y
CONFIG_INPUT_THREAD_STACK_SIZE=1024
CONFIG_CBPRINTF_COMPLETE=y
CONFIG_CBPRINTF_FP_SUPPORT=y
CONFIG_SHELL=y
CONFIG_INIT_STACKS=n
CONFIG_KERNEL_SHELL=n
CONFIG_THREAD_MONITOR=n
CONFIG_BOOT_BANNER=n
CONFIG_THREAD_NAME=n
CONFIG_DEVICE_SHELL=n
CONFIG_POSIX_CLOCK=y
CONFIG_DATE_SHELL=n
CONFIG_THREAD_RUNTIME_STATS=n
CONFIG_THREAD_RUNTIME_STATS_USE_TIMING_FUNCTIONS=n
CONFIG_STATS=n
CONFIG_STATS_SHELL=n
CONFIG_SHELL_BACKEND_SERIAL_CHECK_DTR=y
CONFIG_UART_LINE_CTRL=y
CONFIG_SHELL_BACKEND_SERIAL_INIT_PRIORITY=51
CONFIG_USB_DEVICE_INITIALIZE_AT_BOOT=n
CONFIG_SHELL_MINIMAL=y
CONFIG_SHELL_DEFAULT_TERMINAL_WIDTH=120
CONFIG_SHELL_PROMPT_UART="endgame$ "
CONFIG_SHELL_TAB=y
CONFIG_SHELL_TAB_AUTOCOMPLETION=y
CONFIG_SHELL_WILDCARD=y
CONFIG_SHELL_VT100_COLORS=y
CONFIG_SHELL_METAKEYS=y
CONFIG_SHELL_HELP=y
CONFIG_SHELL_CMDS=y
CONFIG_SHELL_CMDS_RESIZE=n
CONFIG_SHELL_CMD_BUFF_SIZE=255
CONFIG_SHELL_ARGC_MAX=72
CONFIG_SHELL_PRINTF_BUFF_SIZE=64
CONFIG_SHELL_HISTORY=y
CONFIG_FLASH_SHELL=n
CONFIG_ZMK_P2SM_SHELL=y
CONFIG_LOG_MODE_DEFERRED=y
CONFIG_PWM_SHELL=n
CONFIG_ADC_SHELL=n
CONFIG_HWINFO_SHELL=n
CONFIG_CLOCK_CONTROL_NRF_SHELL=n
CONFIG_SHELL_BACKEND_SERIAL_TX_RING_BUFFER_SIZE=96
CONFIG_SHELL_BACKEND_SERIAL_RX_RING_BUFFER_SIZE=96
CONFIG_PM_DEVICE_RUNTIME=y
CONFIG_USB_CDC_ACM_LOG_LEVEL_OFF=n
CONFIG_USB_CDC_ACM_RINGBUF_SIZE=2048
CONFIG_LOG_BUFFER_SIZE=2048
CONFIG_LOG_PROCESS_THREAD_SLEEP_MS=25
CONFIG_UART_0_NRF_TX_BUFFER_SIZE=128
CONFIG_SPI_NRFX_RAM_BUFFER_SIZE=24
CONFIG_SHELL_PRINTF_BUFF_SIZE=128
CONFIG_SHELL_HISTORY_BUFFER=24
CONFIG_USB_REQUEST_BUFFER_SIZE=192
CONFIG_BT_BUF_ACL_RX_SIZE=69
CONFIG_BT_BUF_ACL_TX_SIZE=72
CONFIG_ZMK_BLE_THREAD_STACK_SIZE=1024
CONFIG_PM_DEVICE_SYSTEM_MANAGED=y
CONFIG_BT_DEVICE_APPEARANCE=962
```
