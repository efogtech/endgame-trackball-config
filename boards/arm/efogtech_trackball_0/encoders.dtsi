#include "behaviors/follower.dtsi"

/ {
	left_encoder: encoder_left {
		compatible = "efog,ec11-ish";
		a-gpios = <&gpio0 17 GPIO_PULL_UP>;
		b-gpios = <&gpio0 16 GPIO_PULL_UP>;
		steps = <24>;
		pulses = <4>;
	};

	right_encoder: encoder_right {
		compatible = "efog,ec11-ish";
		a-gpios = <&gpio1 8 GPIO_PULL_UP>;
		b-gpios = <&gpio1 9 GPIO_PULL_UP>;
		steps = <24>;
		pulses = <4>;
	};

	sensors: sensors {
		compatible = "zmk,keymap-sensors";
		sensors = <&left_encoder &right_encoder>;
		triggers-per-rotation = <24>;
	};
};

&left_encoder { status = "okay"; };
&right_encoder { status = "okay"; };
