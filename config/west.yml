## config/west.yml
```yaml
manifest:
  remotes:
    - name: efogdev
      url-base: https://github.com/efogdev
  projects:
    - name: zmk
      remote: efogdev
      revision: "a3f7e5c7"
      import: app/west.yml
    - name: zmk-pmw3610-driver
      remote: efogdev
      revision: "b5de934"
    - name: zmk-pointer-2s-mixer
      remote: efogdev
      revision: "21e94d2"
    - name: zmk-axis-clamper
      remote: efogdev
      revision: "637719f"
    - name: zmk-report-rate-limit
      remote: efogdev
      revision: "20e0742"
    - name: zmk-ec11-ish-driver
      remote: efogdev
      revision: "7b0828b"
    - name: zmk-auto-hold
      remote: efogdev
      revision: "e3b649f"
    - name: zmk-adaptive-feedback
      remote: efogdev
      revision: "c90c877"
    - name: zmk-behavior-follower
      remote: efogdev
      revision: "c27fe57"
    - name: zmk-keymap-shell
      remote: efogdev
      revision: "b712a64"
    - name: zmk-acceleration-curves
      remote: efogdev
      revision: "09a49e1"
    - name: zmk-input-processor-rotate-plane
      remote: efogdev
      revision: "86901be"
    - name: zmk-runtime-config
      remote: efogdev
      revision: "55fabb6"
    - name: zmk-bistable-behavior
      remote: efogdev
      revision: "652ae06"
    - name: zmk-ble-shell
      remote: efogdev
      revision: "3aa9bfa"
    - name: zmk-esb-endpoint
      remote: efogdev
      revision: "d482f54"
      submodules: true
    - name: zmk-feedback-common
      remote: efogdev
      revision: "92251ce"
    - name: zmk-shell-relay-core
      remote: efogdev
      revision: "7dbb118"
  self:
    path: config
```
